## config/west.yml
```yaml
manifest:
  remotes:
    - name: zmkfirmware
      url-base: https://github.com/zmkfirmware
    - name: mentako-ya
      url-base: https://github.com/mentako-ya
  projects:
    - name: zmk
      remote: zmkfirmware
      revision: main
      import: app/west.yml
    - name: zmk-pmw3610-driver
      remote: mentako-ya
      revision: main
    - name: zmk-rgbled-widget
      remote: mentako-ya
      revision: main
  self:
    path: config
```
